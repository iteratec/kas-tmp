## sources-iteratec/meta-iteratec-tmp/conf/layer.conf
```bitbake
# We have a conf and classes directory, add to BBPATH
BBPATH .= ":${LAYERDIR}"

# We have recipes-* directories, add to BBFILES
BBFILES += "${LAYERDIR}/recipes-*/*/*.bb \
            ${LAYERDIR}/recipes-*/*/*.bbappend"

BBFILE_COLLECTIONS += "meta-iteratec-tmp"
BBFILE_PATTERN_meta-iteratec-tmp = "^${LAYERDIR}/"
BBFILE_PRIORITY_meta-iteratec-tmp = "6"

LAYERDEPENDS_meta-iteratec-tmp = "core"
LAYERSERIES_COMPAT_meta-iteratec-tmp = "dunfell"
```
